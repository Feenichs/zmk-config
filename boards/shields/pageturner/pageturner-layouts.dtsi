#include <physical_layouts.dtsi>

/ {
    physical_layout_pageturner: physical_layout_pageturner {
        compatible = "zmk,physical-layout";
        display-name = "PageTurner";
        keys  //                     w   h    x    y     rot    rx    ry
            = <&key_physical_attrs 100 100(-150)    0       0(-150)     0>
            , <&key_physical_attrs 100 100    0    0       0     0     0>
            ;
    };
};
