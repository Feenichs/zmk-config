#include "pageturner-layouts.dtsi"
#include <dt-bindings/zmk/matrix_transform.h>

/ {
    matrix_transform0: matrix_transform0 {
        compatible = "zmk,matrix-transform";
        columns = <3>;
        rows = <1>;
        map = <
            RC(0,0) RC(0,1) RC(0,3)
        >;
    };
};

&physical_layout_pageturner {
    transform = <&matrix_transform0>;
};

